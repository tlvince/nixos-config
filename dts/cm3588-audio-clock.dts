/dts-v1/;
/plugin/;

#include <dt-bindings/clock/rockchip,rk3588-cru.h>

/ {
	compatible = "friendlyarm,cm3588-nas", "friendlyarm,cm3588", "rockchip,rk3588";
};

&i2c7 {
	rt5616: audio-codec@1b {
		clocks = <&cru I2S0_8CH_MCLKOUT>;
		clock-names = "mclk";
		assigned-clocks = <&cru I2S0_8CH_MCLKOUT>;
		assigned-clock-rates = <12288000>;
	};
};
